// Copyright 2023 QMK
// SPDX-License-Identifier: GPL-2.0-or-later

#define NUM_LISTENERS 1

#include <stdint.h>
#include <stdbool.h>
#include QMK_KEYBOARD_H

#if defined(ENCODER_MAP_ENABLE)
const uint16_t PROGMEM encoder_map[][NUM_ENCODERS][NUM_DIRECTIONS] = {
    [0] = { ENCODER_CCW_CW(KC_AUDIO_VOL_UP, KC_AUDIO_VOL_DOWN) },
    [1] = { ENCODER_CCW_CW(KC_BRIGHTNESS_UP, KC_BRIGHTNESS_DOWN)}
};
#endif

#if defined(OLED_ENABLE)

bool oled_task_user()
{
    static char buffer[8];

    static const char PROGMEM bitmap_data[] = {
        0x00, 0x00, 0x00, 0x02, 0x00, 0x00, 0x00, 0x00, 0x00, 0x00, 0x00, 0x00, 0x00, 0x00, 0x00, 0x00,
        0x00, 0x00, 0x00, 0x04, 0x00, 0x00, 0x00, 0x00, 0x00, 0x00, 0x00, 0x00, 0x00, 0x00, 0x00, 0x00,
        0x00, 0x00, 0x00, 0x00, 0x80, 0x00, 0x00, 0x00, 0x00, 0x00, 0x00, 0x00, 0x00, 0x00, 0x00, 0x00,
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        0x1F, 0xFF, 0xFF, 0x00, 0x00, 0x00, 0x00, 0x00, 0x00, 0x00, 0x00, 0x00, 0x00, 0x00, 0x00, 0x00,
    };

    oled_set_cursor(0,0);

    oled_write_raw_P(bitmap_data, sizeof(bitmap_data));

    oled_set_cursor(76, 24);

    snprintf(buffer, sizeof(buffer), "WPM: %d", get_current_wpm());

    oled_write_ln(buffer, false);

    return false;
}

#endif

const uint8_t PROGMEM specialKeys[NUM_LISTENERS] = {
    GP3,
};

const uint16_t PROGMEM keymaps[][MATRIX_ROWS][MATRIX_COLS] = {
    /*
     * ┌───┬───┬───┐
     * │ A │ B │ C │
     * ├───┼───┼───┤
     * │ D │ E │ F │
     * ├───┼───┼───┤
     * │ G │ H │ I │
     * └───┴───┴───┘
     */
    [0] = LAYOUT_ortho_3x3(
        QK_PROGRAMMABLE_BUTTON_1,    QK_PROGRAMMABLE_BUTTON_2,    QK_PROGRAMMABLE_BUTTON_3,
        QK_PROGRAMMABLE_BUTTON_4,    QK_PROGRAMMABLE_BUTTON_5,    QK_PROGRAMMABLE_BUTTON_6,
        MO(1),    QK_PROGRAMMABLE_BUTTON_7,    QK_PROGRAMMABLE_BUTTON_8
    ),

    [1] = LAYOUT_ortho_3x3(
        QK_PROGRAMMABLE_BUTTON_9, QK_DEBUG_TOGGLE, QK_BOOTLOADER,
        QK_PROGRAMMABLE_BUTTON_10, QK_PROGRAMMABLE_BUTTON_11, QK_PROGRAMMABLE_BUTTON_12,
        QK_PROGRAMMABLE_BUTTON_13, QK_PROGRAMMABLE_BUTTON_14, QK_PROGRAMMABLE_BUTTON_15
    )
};



void onPinActivation(uint16_t key)
{
    switch (key)
    {
    case GP3:
        uint8_t current_layer = get_highest_layer(layer_state);

        switch (current_layer)
        {
        case 0:
            tap_code(KC_AUDIO_MUTE);
            break;

        case 1:
            tap_code(KC_WWW_SEARCH);
            break;
        }

        break;
    }
}

void matrix_scan_user(void)
{
    static bool last_state[NUM_LISTENERS] = { false };

    for(int i = 0; i < NUM_LISTENERS; i++)
    {
        if(last_state[i]) continue;

        if(gpio_read_pin(specialKeys[i]))
        {
            onPinActivation(specialKeys[i]);
        }

    }
}
